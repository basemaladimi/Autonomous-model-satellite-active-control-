## apps/01_blink/boards/rpi_pico.conf
```kconfig
CONFIG_USB_DEVICE_STACK=y
CONFIG_USB_DEVICE_VID=0x2FE3
CONFIG_USB_DEVICE_PID=0x0004
CONFIG_USB_DEVICE_PRODUCT="USB CDC-ACM serial console"
CONFIG_USB_DEVICE_INITIALIZE_AT_BOOT=y
```

## apps/03_demo_kconfig/boards/esp32s3_devkitc.conf
```kconfig
# CONFIG_STACK_CANARIES is not set
CONFIG_STACK_POINTER_RANDOM=0
CONFIG_TEST_RANDOM_GENERATOR=y
CONFIG_TIMER_RANDOM_GENERATOR=y
CONFIG_TEST_CSPRNG_GENERATOR=y
# CONFIG_SAY_HELLO=y
```

## apps/03_demo_kconfig/boards/rpi_pico.conf
```kconfig
CONFIG_STACK_POINTER_RANDOM=0
CONFIG_TEST_RANDOM_GENERATOR=y
CONFIG_TIMER_RANDOM_GENERATOR=y
CONFIG_TEST_CSPRNG_GENERATOR=y
CONFIG_SAY_HELLO=y

CONFIG_USB_DEVICE_STACK=y
CONFIG_USB_DEVICE_VID=0x2FE3
CONFIG_USB_DEVICE_PID=0x0004
CONFIG_USB_DEVICE_PRODUCT="USB CDC-ACM serial console"
CONFIG_USB_DEVICE_INITIALIZE_AT_BOOT=y
```

## apps/03_solution_kconfig_float/boards/esp32s3_devkitc.conf
```kconfig
# CONFIG_STACK_CANARIES is not set
CONFIG_STACK_POINTER_RANDOM=0
CONFIG_TEST_RANDOM_GENERATOR=y
CONFIG_TIMER_RANDOM_GENERATOR=y
CONFIG_TEST_CSPRNG_GENERATOR=y

# Print floats using software:
CONFIG_PICOLIBC_IO_FLOAT=y

# Print floats using hardware acceleration:
# CONFIG_FPU=y
```

## boards/custom/my_board/board.yml
```yaml
board:
  name: my_board
  full_name: My Board
  vendor: custom
  socs:
  - name: esp32s3
```

## boards/custom/nyan/board.yml
```yaml
board:
  name: nyan
  full_name: Nyan
  vendor: custom
  socs:
  - name: esp32s3
```

## firmware/boards/custom/my_board/Kconfig.my_board
```kconfig
config BOARD_MY_BOARD
	select SOC_ESP32S3_WROOM_N8
	select SOC_ESP32S3_PROCPU if BOARD_NYAN_ESP32S3_PROCPU
```

## firmware/boards/custom/nyan/Kconfig.nyan
```kconfig
config BOARD_NYAN
    select SOC_ESP32S3_WROOM_N8
    select SOC_ESP32S3_PROCPU if BOARD_NYAN_ESP32S3_PROCPU
```

## firmware/modules/button/dts/bindings/input/custom,button.yaml
```yaml
# Description of the device
description: Custom button

# Compatibility string that matches the one in the Devicetree source and
# DT_DRV_COMPAT macro in the driver source code
compatible: "custom,button"

# Define the required node properties
properties:
  pin:
    type: phandle
    required: true
```

## modules/button/drivers/button/Kconfig
```kconfig
# Create a new option in menuconfig
config CUSTOM_BUTTON
    bool "Custom button"
    default n       # Set the driver to be disabled by default
    depends on GPIO # Make it dependent on GPIO driver
    help
        Enable the custom button driver.
```

## west.yml
```yaml
manifest:
  defaults:
    remote: zephyrproject-rtos

  remotes:
    - name: zephyrproject-rtos
      url-base: https://github.com/zephyrproject-rtos

  projects:
    - name: zephyr
      remote: zephyrproject-rtos
      revision: v4.0.0
      import:

        name-allowlist:
          - cmsis
          - hal_xtensa
          - hal_espressif
          - hal
          - mbedtls
```
